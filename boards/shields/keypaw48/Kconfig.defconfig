## boards/shields/keypaw48/Kconfig.defconfig
```kconfig
if SHIELD_KEYPAW48

config ZMK_KEYBOARD_NAME
    default "keypaw48"

endif # SHIELD_KEYPAW48
```

## boards/shields/keypaw48/Kconfig.shield
```kconfig
config SHIELD_KEYPAW48_LEFT
    def_bool $(shields_list_contains,keypaw48_left)

config SHIELD_KEYPAW48_RIGHT
    def_bool $(shields_list_contains,keypaw48_right)
```

## modules/zmk-behavior-dynamic-macro/dts/bindings/behaviors/zmk,behavior-dynamic-macro.yaml
```yaml
# Copyright (c) 2026 The ZMK Contributors
# SPDX-License-Identifier: MIT

description: Dynamic Macro Behavior

compatible: "zmk,behavior-dynamic-macro"

include: two_param.yaml
```

## modules/zmk-behavior-dynamic-macro/dts/bindings/keypaw,rgb-condition-dynamic-macro.yaml
```yaml
# Copyright (c) 2026 The ZMK Contributors
# SPDX-License-Identifier: MIT

description: |
  Dynamic macro recording condition: active while &dm is recording a take into a
  scratch buffer. State is sampled on every RGB tick through the module's
  internal accessor, so there is nothing to subscribe to.

  Pair it with a default (central-evaluated) overlay, because the recorder exists
  only on the split central.

compatible: "keypaw,rgb-condition-dynamic-macro"
```

## modules/zmk-behavior-dynamic-macro/dts/bindings/keypaw,rgb-indicator-dynamic-macro.yaml
```yaml
# Copyright (c) 2026 The ZMK Contributors
# SPDX-License-Identifier: MIT

description: |
  Dynamic macro recording indicator: paints its targeted LEDs while &dm is
  recording a take into a scratch buffer. State is sampled on every RGB tick
  through the module's internal accessor, so there is nothing to subscribe to.

compatible: "keypaw,rgb-indicator-dynamic-macro"

include: ["keypaw,rgb-indicator-common.yaml"]
```

## modules/zmk-driver-ft6236/Kconfig
```kconfig
# Copyright (c) 2026 The ZMK Contributors
# SPDX-License-Identifier: MIT

# FT6236 capacitive touch panel driver

config FT6236
        bool "FT6236 capacitive touch panel driver"
        default y
        depends on DT_HAS_FOCALTECH_FT6236_ENABLED
        select I2C
        select GPIO
        select INPUT
        select INPUT_TOUCH
        help
          Enable driver for the FocalTech FT6236/FT6x36 family self-capacitive
          touch controllers. Classifies gestures in firmware from the contact
          geometry and emits one key event per gesture, held from recognition
          until the contact lifts, for the central half to map onto behaviours.

module = FT6236
module-str = FT6236
source "${ZEPHYR_BASE}/subsys/logging/Kconfig.template.log_config"
```

## modules/zmk-driver-ft6236/dts/bindings/focaltech,ft6236.yaml
```yaml
# Copyright (c) 2026 The ZMK Contributors
# SPDX-License-Identifier: MIT

description: FocalTech FT6236/FT6x36 capacitive touch panels

compatible: "focaltech,ft6236"

include: [i2c-device.yaml, touchscreen-common.yaml]

properties:
  int-gpios:
    type: phandle-array
    description: |
      Interrupt GPIO. Used by the controller to signal touch data is
      available. Active low.

  reset-gpios:
    type: phandle-array
    description: |
      Reset GPIO. Used to reset the controller during initialization, and
      to wake it from hibernation mode. Active low.

  gesture-swipe-distance:
    type: int
    default: 25
    description: |
      Minimum travel, in raw panel units (the same units as screen-width /
      screen-height), before movement counts as a swipe. For a one-finger swipe
      it is the travel of the contact; for a two-finger swipe it is the travel of
      the midpoint between the two contacts. The FT6x36's own gesture engine
      defaults DISTANCE_UP_DOWN and DISTANCE_LEFT_RIGHT to 25, which is a
      reasonable starting point. Directions are reported in the keyboard's frame:
      inverted-x / inverted-y / swapped-x-y are applied to the measured travel.

  gesture-swipe-timeout-ms:
    type: int
    default: 500
    description: |
      Maximum time between a gesture starting and covering
      gesture-swipe-distance, for the movement to count as a swipe. 0 disables
      the limit. For a one-finger swipe this is a second limit on top of
      gesture-press-settle-ms: the flick has to start inside the settle window,
      so a finger that dwells and then drags is a press/drag, not a swipe. A
      two-finger pair that is still moving only slowly after this is left alone
      (and can still be read as a two-finger tap if it then lifts).

  gesture-pinch-distance:
    type: int
    default: 25
    description: |
      Minimum change in the distance between two contacts, in raw panel units,
      before it counts as Zoom In (fingers separating) or Zoom Out (fingers
      closing). A pinch is only reported when the separation changed more than
      the pair's midpoint moved, so a two-finger swipe that spreads the fingers
      slightly still reads as a swipe.

  gesture-press-settle-ms:
    type: int
    default: 40
    description: |
      Delay, in ms, before a single-finger contact is committed as
      FT6236_GESTURE_PRESS. It exists so a second finger landing shortly after
      the first (the start of a pinch or two-finger swipe) cancels the press
      instead of emitting a stray left click. A finger that lifts inside the
      delay is still reported, as a one-shot tap, so a quick tap clicks. The
      window doubles as the one-finger flick window: if the finger crosses
      gesture-swipe-distance inside it the contact is reported as a swipe
      instead of a press. Raise it if flicks are being missed; 0 commits the
      press on the first contact frame and disables one-finger swipes.

  gesture-tap-timeout-ms:
    type: int
    default: 250
    description: |
      Maximum lifetime, in ms, of a two-finger pair that triggers neither a
      pinch nor a two-finger swipe, for its lift to count as
      FT6236_GESTURE_TWO_FINGER_TAP. A pair held longer than this is not a tap.
      0 disables the time limit.

  gesture-poll-ms:
    type: int
    default: 500
    description: |
      While a gesture session is open the driver re-reads the panel at this
      interval, so a lift interrupt that was missed (an I2C error, or an edge
      coalesced behind the read that was already running) still releases a held
      gesture instead of leaving a mouse button stuck down. 0 disables the poll.
```

## modules/zmk-driver-ft6236/dts/bindings/input_processors/zmk,input-processor-ft6236-scroll.yaml
```yaml
# Copyright (c) 2026 The ZMK Contributors
# SPDX-License-Identifier: MIT

description: |
  Input processor that consumes the FT6236 single-touch frames on the central
  half and converts the pressed contact's coordinates into relative scroll
  wheel events (REL_HWHEEL / REL_WHEEL). All events are swallowed so the core
  input listener does not treat BTN_TOUCH as a mouse click.

  The per-listener param cells control scroll sensitivity and are in the same
  units as the incoming coordinates, i.e. raw panel pixels: param1 is the X
  pixels per wheel notch, param2 the Y pixels per notch (0 is treated as 1).
  Lower is faster. With CONFIG_ZMK_POINTING_SMOOTH_SCROLLING enabled, deltas are
  emitted in 1/16-notch subunits for hosts that support HID Resolution
  Multipliers; a notch still takes a whole param-worth of pixels.

  Per-touch totals (pixels travelled vs subunits emitted) are logged at debug
  level, so the params can be checked against real travel.

compatible: "zmk,input-processor-ft6236-scroll"

include: ip_two_param.yaml

properties:
  scroll-natural:
    type: boolean
    description: |
      Natural scrolling direction: moving the finger up scrolls the content up
      (wheel negative), matching real touchpads. When absent, scroll direction
      follows a traditional mouse wheel.
```

## modules/zmk-driver-ft6236/dts/bindings/input_processors/zmk,input-processor-ft6236-touchpad.yaml
```yaml
# Copyright (c) 2026 The ZMK Contributors
# SPDX-License-Identifier: MIT

description: |
  Input processor that consumes FT6236 multitouch input events on the central
  half: one contact is converted into relative scroll wheel events (REL_HWHEEL
  / REL_WHEEL), two or more contacts are forwarded as Windows Precision
  Touchpad (Digitizer 0x0D) HID reports. All events are swallowed so the core
  input listener does not treat BTN_TOUCH as a mouse click.

  The per-listener param cells control single-finger scroll sensitivity:
  param1 is the X axis divisor, param2 the Y axis divisor, both in logical
  touchpad units per wheel notch (0 is treated as 1). With
  CONFIG_ZMK_POINTING_SMOOTH_SCROLLING enabled, deltas are emitted in
  1/16-notch subunits for hosts that support HID Resolution Multipliers.

compatible: "zmk,input-processor-ft6236-touchpad"

include: ip_two_param.yaml

properties:
  scroll-natural:
    type: boolean
    description: |
      Natural scrolling direction for single-finger scroll: moving the finger
      up scrolls the content up (wheel negative), matching real touchpads.
      When absent, scroll direction follows a traditional mouse wheel.
  physical-width:
    type: int
    required: true
    description: |
      Physical width of the touch surface in 1/100 inch, reported as the
      HID descriptor PHYSICAL_MAXIMUM of the X axis (the descriptor declares
      UNIT_EXPONENT(-2) + UNIT(Inch)). Measure the actual digitizer active
      area; the host derives scroll velocity from it.
  physical-height:
    type: int
    required: true
    description: |
      Physical height of the touch surface in 1/100 inch, reported as the
      HID descriptor PHYSICAL_MAXIMUM of the Y axis.
```

## modules/zmk-driver-jd9613/dts/bindings/behaviors/zmk,behavior-jd9613-brightness.yaml
```yaml
# Copyright (c) 2026 The ZMK Contributors
# SPDX-License-Identifier: MIT

description: JD9613 display brightness control behavior

compatible: "zmk,behavior-jd9613-brightness"

include: one_param.yaml
```

## modules/zmk-driver-jd9613/dts/bindings/jadard,jd9613.yaml
```yaml
# Copyright (c) 2024 The ZMK Contributors
# SPDX-License-Identifier: MIT

description: JD9613 LTPS AMOLED display controller

compatible: "jadard,jd9613"

include: [spi-device.yaml, display-controller.yaml]

properties:
  dc-gpios:
    type: phandle-array
    description: Data/Command select pin

      DC high selects data, DC low selects command.

  reset-gpios:
    type: phandle-array
    description: Reset pin (active-low)

      Pulled low to reset the panel, then released high.
      Should be configured as GPIO_ACTIVE_LOW.

  width:
    type: int
    required: true
    description: Panel width in pixels

  height:
    type: int
    required: true
    description: Panel height in pixels
```

## modules/zmk-feature-boot-layers/Kconfig
```kconfig
config KEYPAW_BOOT_LAYERS
    bool "Boot layer activator"
    depends on DT_HAS_KEYPAW_BOOT_LAYERS_ENABLED
    default y if !ZMK_SPLIT || ZMK_SPLIT_ROLE_CENTRAL
    help
      Activate a configured set of keymap layers once at boot, so the layer
      status widget shows the intended layout name from power-on. Central-only:
      keymap layer state does not exist on a split peripheral, and the layer
      widget is central-only anyway.

if KEYPAW_BOOT_LAYERS

config KEYPAW_BOOT_LAYERS_INIT_PRIORITY
    int "Boot layer activator init priority (APPLICATION)"
    default 91
    help
      Must run after keymap_init (APPLICATION, CONFIG_APPLICATION_INIT_PRIORITY,
      default 90). Keep it > 90.

endif
```

## modules/zmk-feature-boot-layers/dts/bindings/keypaw,boot-layers.yaml
```yaml
description: Layers to activate once at boot

compatible: "keypaw,boot-layers"

properties:
  layers:
    type: array
    required: true
    description: |
      Keymap layer IDs to activate once at boot.
```

## modules/zmk-feature-shared-reset/Kconfig
```kconfig
config KEYPAW_SHARED_RESET
    bool "Shared hardware reset line sequencer"
        default y
        depends on DT_HAS_KEYPAW_SHARED_RESET_ENABLED
        select GPIO
        help
          Assert the shared hardware reset line once at boot, hold it, then
          release it. On the keypaw48 one net resets several chips at once
          (touch panel + display on the left, motion sensor + display on the
          right), so no single driver may own it.

if KEYPAW_SHARED_RESET

config KEYPAW_SHARED_RESET_INIT_PRIORITY
    int "Shared reset init priority (POST_KERNEL)"
    default 82
    help
          Must run after ZMK_EXT_POWER_INIT_PRIORITY (81), which switches the
          peripheral rails on and settles them, and before
          CONFIG_DISPLAY_INIT_PRIORITY (85) and CONFIG_INPUT_INIT_PRIORITY (90),
          so that every device on the shared line initializes after the reset
          has been released.

endif
```

## modules/zmk-feature-shared-reset/dts/bindings/keypaw,shared-reset.yaml
```yaml
description: Shared hardware reset line

compatible: "keypaw,shared-reset"

properties:
  reset-gpios:
    type: phandle-array
    required: true
    description: |
      Shared RESET net. It is driven to its active level at boot, held
      there for reset-hold-ms, then released. Every chip wired to this net
      gets a power-on reset, so it must not be claimed by another driver.
  reset-hold-ms:
    type: int
    default: 10
    description: |
      How long the line is held asserted. Must exceed the slowest chip's
      minimum reset pulse (FT6x36 ~5 ms, JD9613 ~50 us).
  release-wait-ms:
    type: int
    default: 10
    description: Optional settle time after the line is released.
```

## modules/zmk-input-processor-axis-tap/Kconfig
```kconfig
# Copyright (c) 2026 The ZMK Contributors
# SPDX-License-Identifier: MIT

config ZMK_INPUT_PROCESSOR_AXIS_TAP
    bool "Axis-tap input processor"
    default y
    depends on DT_HAS_ZMK_INPUT_PROCESSOR_AXIS_TAP_ENABLED
    help
      Converts relative pointing-device motion into discrete taps of a set of
      behaviours (for example arrow keys), one tap per accumulated threshold on
      the dominant axis. Pair with a zmk,input-listener layer override to get
      cursor-key behaviour from a trackball while a layer is held.
```

## modules/zmk-input-processor-axis-tap/dts/bindings/zmk,input-processor-axis-tap.yaml
```yaml
# Copyright (c) 2026 The ZMK Contributors
# SPDX-License-Identifier: MIT

description: |
  Input processor that turns relative motion into discrete behavioural taps,
  one per accumulated threshold on the dominant axis.

compatible: "zmk,input-processor-axis-tap"

include: ip_zero_param.yaml

properties:
  x-threshold:
    type: int
    required: true
    description: |
      Horizontal travel (sum of REL_X values) needed to emit one tap.
      Positive REL_X -> bindings[1] (right); negative -> bindings[0] (left).
  y-threshold:
    type: int
    required: true
    description: |
      Vertical travel (sum of REL_Y values) needed to emit one tap.
      Positive REL_Y -> bindings[3] (down); negative -> bindings[2] (up).
  bindings:
    type: phandle-array
    required: true
    description: |
      Exactly four behaviours, in order: left, right, up, down.
```

## modules/zmk-input-processor-rel-throttle/Kconfig
```kconfig
# Copyright (c) 2026 The ZMK Contributors
# SPDX-License-Identifier: MIT

config ZMK_INPUT_PROCESSOR_REL_THROTTLE
    bool "Relative-motion report throttle input processor"
    default y
    depends on DT_HAS_ZMK_INPUT_PROCESSOR_REL_THROTTLE_ENABLED
    help
      Coalesces relative pointing-device motion so at most one HID report per
      interval is sent, while keeping every reported delta (nothing is
      dropped). The interval is selected at runtime from the active endpoint
      transport, so USB can stay unthrottled while BLE is throttled enough for
      the HID-over-GATT report queue to keep up.

      Place it first in a zmk,input-listener input-processors chain, and in the
      listener's base config as well as any layer overrides, since a matching
      override with process-next unset does not fall through to the base chain.
```
