## modules/zmk-input-processor-rel-throttle/dts/bindings/zmk,input-processor-rel-throttle.yaml
```yaml
# Copyright (c) 2026 The ZMK Contributors
# SPDX-License-Identifier: MIT

description: |
  Input processor that rate-limits relative motion reports.

  The ZMK input listener accumulates REL_X/REL_Y/REL_WHEEL/REL_HWHEEL and only
  emits a HID report when an event carries the sync flag. This processor clears
  that flag while less than the selected interval has elapsed since the last
  report we let through, so the listener keeps accumulating and a later event
  reports the whole accumulated delta at once. Deltas are preserved; only the
  number of reports is reduced.

  The interval is picked per event from zmk_endpoint_get_selected().transport,
  so a single set of interval values covers both transports.

  Must be placed first in the input-processors chain so it sees raw motion.
  Use an interval of 0 to disable throttling for that transport.

compatible: "zmk,input-processor-rel-throttle"

include: ip_zero_param.yaml

properties:
  ble-interval-ms:
    type: int
    default: 15
    description: |
      Minimum interval between relative-motion HID reports when the active
      endpoint is BLE, in milliseconds. 0 disables throttling.
  usb-interval-ms:
    type: int
    default: 0
    description: |
      Minimum interval between relative-motion HID reports when the active
      endpoint is USB, in milliseconds. 0 disables throttling.
```

## modules/zmk-rgb-effect-example/Kconfig
```kconfig
# Copyright (c) 2026 The ZMK Contributors
# SPDX-License-Identifier: MIT

config ZMK_RGB_EFFECT_EXAMPLE
    bool "Example custom RGB matrix effect (fx_example)"
    default y
    depends on KEYPAW_RGB_MATRIX
    depends on KEYPAW_BEHAVIOR_RGB_MATRIX
    depends on DT_HAS_KEYPAW_RGB_MATRIX_EXAMPLE_ENABLED
    help
      A worked example of adding a brand-new RGB matrix effect from a *separate*
      module, with no edits to zmk-rgb-matrix. Provides the
      keypaw,rgb-matrix-example compatible and an fx_example child node of &kprgb.
```

## modules/zmk-rgb-effect-example/dts/bindings/keypaw,rgb-matrix-example.yaml
```yaml
# Copyright (c) 2026 The ZMK Contributors
# SPDX-License-Identifier: MIT

description: |
  Example custom keypaw RGB matrix effect, demonstrating the extension point. Declared
  as a child node of the &kprgb behavior (e.g. fx_example { ... }); referenced from a
  keymap by name (&fx_example). The engine identifies the effect by its position among
  &kprgb's children, so declaration order is the on-wire identity.

  This compatible lives in the separate zmk-rgb-effect-example module to prove a new
  effect can be added without editing zmk-rgb-matrix.

compatible: "keypaw,rgb-matrix-example"

include: [zero_param.yaml, "keypaw,rgb-matrix-effect-common.yaml"]

properties:
  tail-length:
    type: int
    required: false
    default: 200
    description: |
      Custom field -- how far behind the comet head the fade extends, in the same
      physical-layout units as the LEDs (100 = one key width).
```
